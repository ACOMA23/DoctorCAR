## firmware/main/Kconfig.projbuild
```kconfig
menu "DoctorCAR M1 test data"
    config DOCTORCAR_TEST_THERMAL
        bool "Generate a thermal demonstration during the test cycle"
        default y
        help
            Generated DEVICE_TEST data only. No CAN or vehicle access is implemented.
endmenu
```

## firmware/sdkconfig.defaults
```kconfig
CONFIG_IDF_TARGET="esp32s3"
CONFIG_ESP_CONSOLE_UART_DEFAULT=y
CONFIG_ESP_CONSOLE_SECONDARY_NONE=y
CONFIG_LOG_DEFAULT_LEVEL_INFO=y
CONFIG_ESP_MAIN_TASK_STACK_SIZE=8192
CONFIG_DOCTORCAR_TEST_THERMAL=y
```
